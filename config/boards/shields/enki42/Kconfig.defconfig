## config/boards/shields/enki42/Kconfig.defconfig
```kconfig
# Copyright (c) 2020 The ZMK Contributors
# SPDX-License-Identifier: MIT

if SHIELD_ENKI42_DONGLE

config ZMK_KEYBOARD_NAME
	default "enki42 Dongle"
	
config ZMK_SPLIT_BLE_ROLE_CENTRAL
	default y
	
config ZMK_USB
	default y

endif

if SHIELD_ENKI42_LEFT || SHIELD_ENKI42_RIGHT || SHIELD_ENKI42_DONGLE 

config ZMK_SPLIT
	default y

config ZMK_BLE
	default y
	
config I2C
    default y

#agregado por zkorpio para funcionamiento oled
if ZMK_DISPLAY

config SSD1306
    	default y

config LV_Z_VDB_SIZE
    	default 64

config LV_DPI_DEF
   	default 148

config LV_Z_BITS_PER_PIXEL
    	default 1

choice LV_COLOR_DEPTH
    	default LV_COLOR_DEPTH_1
endchoice

endif # ZMK_DISPLAY

endif
```
